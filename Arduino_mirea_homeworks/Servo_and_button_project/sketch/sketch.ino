#include <Servo.h>  // Подключаем библиотеку для работы с сервоприводом

Servo myservo;      // Создаем объект класса Servo для управления сервоприводом

const int buttonPin1 = 2; // Пин для первой кнопки
const int buttonPin2 = 3; // Пин для второй кнопки

int pos = 120;       // Начальная позиция сервопривода

void setup() {
  pinMode(9, OUTPUT);
  myservo.attach(9);          // Закрепляем сервопривод за пином 9
  pinMode(buttonPin1, INPUT_PULLUP);  // Настраиваем пин первой кнопки как вход с подтяжкой
  pinMode(buttonPin2, INPUT_PULLUP);  // Настраиваем пин второй кнопки как вход с подтяжкой
}

void loop() {
  if (digitalRead(buttonPin1) == LOW) { // Проверяем, нажата ли первая кнопка
    pos += 5;                           // Увеличиваем позицию
    if (pos > 180) pos = 180;           // Ограничиваем положение до 180
    myservo.write(pos);                 // Устанавливаем позицию сервопривода
    delay(200);                         // Небольшая задержка для защиты от дребезга
  } 
  
  if (digitalRead(buttonPin2) == LOW) { // Проверяем, нажата ли вторая кнопка
    pos -= 5;                           // Уменьшаем позицию
    if (pos < 0) pos = 0;               // Ограничиваем положение до 0
    myservo.write(pos);                 // Устанавливаем позицию сервопривода
    delay(200);                         // Небольшая задержка для защиты от дребезга
  }
}
